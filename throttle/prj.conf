## CMakeLists.txt
```
#-------------------------------------------------------------------------------
# Zephyr Example Application
#
# Copyright (c) 2021 Nordic Semiconductor ASA
# SPDX-License-Identifier: Apache-2.0

cmake_minimum_required(VERSION 3.13.1)
find_package(Zephyr REQUIRED HINTS $ENV{ZEPHYR_BASE})

# For god's sake, why isn't this set automatically?
set(CMAKE_CPP_COMPILER "${CROSS_COMPILE}g++")

message(STATUS "C compiler: ${CMAKE_C_COMPILER}")
message(STATUS "C++ compiler: ${CMAKE_CPP_COMPILER}")

project(app)
target_sources(app PRIVATE src/main.cpp)
target_sources(app PRIVATE src/Server.cpp)
```

## sample.yaml
```
# This file is provided so that the application can be compiled using Twister,
# the Zephyr testing tool. In this file, multiple combinations can be specified,
# so that you can easily test all of them locally or in CI.
sample:
  description: Throttle dev2
  name: throttle
common:
  build_only: true
  integration_platforms:
    - custom_plank
    - nucleo_f302r8
tests:
  app.default: {}
  app.debug:
    extra_overlay_confs:
      - debug.conf
```

## prj.conf
```kconfig
# Copyright (c) 2021 Nordic Semiconductor ASA
# SPDX-License-Identifier: Apache-2.0
#
# This file contains selected Kconfig options for the application.

CONFIG_CPP=y
CONFIG_STD_CPP20=y
CONFIG_SENSOR=y
CONFIG_BLINK=y
CONFIG_LOG_MODE_IMMEDIATE=y
CONFIG_REQUIRES_FULL_LIBC=y
CONFIG_GLIBCXX_LIBCPP=y
CONFIG_NEWLIB_LIBC=y

CONFIG_TIMESLICING=y
CONFIG_TIMESLICE_SIZE=10
CONFIG_TIMESLICE_PRIORITY=5

CONFIG_NETWORKING=y
CONFIG_NET_UDP=n
CONFIG_NET_TCP=y
CONFIG_NET_IPV4=y
CONFIG_INIT_STACKS=y
CONFIG_NET_LOG=y
CONFIG_NET_CONFIG_SETTINGS=y
CONFIG_NET_CONFIG_NEED_IPV4=y
CONFIG_NET_CONFIG_MY_IPV4_ADDR="169.254.99.99"
# CONFIG_NET_CONFIG_MY_IPV4_ADDR="192.168.0.150"
CONFIG_NET_CONFIG_MY_IPV4_NETMASK="255.255.0.0"
# CONFIG_NET_CONFIG_MY_IPV4_NETMASK="255.255.255.0"
# CONFIG_NET_CONFIG_MY_IPV4_GW="192.168.0.1"
CONFIG_NET_L2_ETHERNET=y
CONFIG_NET_CONFIG_INIT_TIMEOUT=0
CONFIG_NET_CONTEXT_RCVTIMEO=y
CONFIG_NET_SOCKETS=y
CONFIG_NET_TX_STACK_SIZE=4096
CONFIG_NET_RX_STACK_SIZE=4096
CONFIG_SYSTEM_WORKQUEUE_STACK_SIZE=4096
CONFIG_NET_PKT_RX_COUNT=64
CONFIG_NET_PKT_TX_COUNT=64
CONFIG_NET_BUF_RX_COUNT=64
CONFIG_NET_BUF_TX_COUNT=64
CONFIG_NET_MAX_CONN=64
CONFIG_NET_MAX_CONTEXTS=64
CONFIG_NET_LOG=y
#CONFIG_NET_TCP_LOG_LEVEL_DBG=y
#CONFIG_NET_CONTEXT_LOG_LEVEL_DBG=y
#CONFIG_NET_SOCKETS_LOG_LEVEL_DBG=y
CONFIG_ADC=y
CONFIG_ADC_LOG_LEVEL_WRN=y

CONFIG_PWM=y
CONFIG_I2C=y
CONFIG_PWM_PCA9685=y

CONFIG_PRINTK=y
CONFIG_SERIAL=y
CONFIG_UART_CONSOLE=y
CONFIG_USB_DEVICE_STACK=n
CONFIG_LOG=y
CONFIG_LOG_BACKEND_UART=y
CONFIG_LOG_MODE_IMMEDIATE=y


CONFIG_NET_CONNECTION_MANAGER=y

CONFIG_NET_TCP_TIME_WAIT_DELAY=0
```

## boards/teensy41.overlay
```dts
/*
Throttle PCB

For GPIO pin assignments, see the schematic for "official number" to MCU number: https://www.pjrc.com/teensy/schematic.html
And to translate MCU pin number to gpio bank + index, see: https://sourcegraph.com/github.com/zephyrproject-rtos/zephyr/-/blob/dts/arm/nxp/nxp_rt1060.dtsi
*/

/ {
	example_sensor: example-sensor {
		compatible = "zephyr,example-sensor";
		input-gpios = <&gpio6 18 (GPIO_PULL_UP | GPIO_ACTIVE_LOW)>;
	};

	blink_led: blink-led {
		compatible = "blink-gpio-led";
		led-gpios = <&gpio2 3 GPIO_ACTIVE_HIGH>;
		blink-period-ms = <1000>;
	};
};
```

## src/main.c
```c
/*
 * Copyright (c) 2021 Nordic Semiconductor ASA
 * SPDX-License-Identifier: Apache-2.0
 */

#include <zephyr/kernel.h>
#include <zephyr/logging/log.h>
#include <zephyr/sys/printk.h>
#include <zephyr/drivers/uart.h>
#include <app/drivers/blink.h>
#include <zephyr/sys/util.h>
#include <string.h>
#include <zephyr/usb/usb_device.h>
#include <zephyr/drivers/uart.h>

LOG_MODULE_REGISTER(main, CONFIG_LOG_DEFAULT_LEVEL);

BUILD_ASSERT(DT_NODE_HAS_COMPAT(DT_CHOSEN(zephyr_console), zephyr_cdc_acm_uart),
		 "Console device is not ACM CDC UART device");

int main(void)
{
	if (usb_enable(NULL)) {
		return 0;
	}
	const struct device *usb_dev = DEVICE_DT_GET(DT_CHOSEN(zephyr_console));
	uint32_t dtr = 0;
	while (!dtr) {
		uart_line_ctrl_get(usb_dev, UART_LINE_CTRL_DTR, &dtr);
		k_sleep(K_MSEC(100));
	}

	const struct device *blink = DEVICE_DT_GET(DT_NODELABEL(blink_led));
	if (!device_is_ready(blink)) {
		LOG_ERR("Blink LED not ready");
		return 0;
	}
	blink_set_period_ms(blink, 1000u);

	printk("HELLO!\n");
	LOG_INF("hello there!");

	blink_set_period_ms(blink, 200u);

	printk("Hello!\n");

	int counter = 0;
	while (1) {
		k_sleep(K_MSEC(2000));
		counter++;
		LOG_INF("Still alive.. %d", counter);
	}

	return 0;
}
```

## src/main.cpp
```c
#include <zephyr/kernel.h>
#include <zephyr/logging/log.h>
#include <zephyr/drivers/uart.h>
#include <zephyr/sys/util.h>
#include <zephyr/usb/usb_device.h>
#include <zephyr/net/net_if.h>
#include <zephyr/net/socket.h>
#include <zephyr/net/net_pkt.h>

#include "server.h"
#include "throttle_valve.h"
//#include "servotesting.h"
#include "pts.h"

extern "C" {
#include <app/drivers/blink.h>
}

LOG_MODULE_REGISTER(main, CONFIG_LOG_DEFAULT_LEVEL);


int main(void) {
    printk("Starting Code %s\n", CONFIG_BOARD);

    // Status LED
    const struct device *blink = DEVICE_DT_GET(DT_NODELABEL(blink_led));
    if (!device_is_ready(blink)) {
        return 0;
    }
    blink_set_period_ms(blink, 100u);


   // const struct device *usb_dev = DEVICE_DT_GET(DT_CHOSEN(zephyr_console));
   // uint32_t dtr = 0;
   // while (!dtr) {
   //     uart_line_ctrl_get(usb_dev, UART_LINE_CTRL_DTR, &dtr);
   //     k_sleep(K_MSEC(100));
   // }

    LOG_INF("Initializing throttle valve");
    printk("Initializing throttle valve\n");
    int err = throttle_valve_init();
    if (err) {
        LOG_ERR("Failed to initialize throttle valve");
        return 0;
    }
    LOG_INF("Initializing servos");
    printk("Initializing servos\n");
    //err = servos_init();
    if (err) {
        LOG_ERR("Failed to initialize servos");
        return 0;
    }

    LOG_INF("Initializing PTs");
    printk("Initializing PTs\n");
    err = pts_init();
    if (err) {
        LOG_ERR("Failed to initialize PTs");
        return 0;
    }

    LOG_INF("Starting server");
    printk("Starting server\n");
    serve_connections();

    //servotesting_demo();

    while (1);
}
```

## src/Server.cpp
```c
//
// Created by lpl on 10/23/25.
//

#include "Server.h"

#include <zephyr/logging/log.h>
#include <zephyr/net/socket.h>

#include <zephyr/net/net_pkt.h>

LOG_MODULE_REGISTER(Server, CONFIG_LOG_DEFAULT_LEVEL);

#define MAX_OPEN_CLIENTS 4
/// Index to connection_threads for unused thread slot. Must be in [0, MAX_OPEN_CLIENTS).
static int next_open_connection = 0;

static k_thread client_threads[MAX_OPEN_CLIENTS] = {nullptr};
#define CONNECTION_THREAD_STACK_SIZE (4 * 1024)
K_THREAD_STACK_ARRAY_DEFINE(client_stacks, MAX_OPEN_CLIENTS, CONNECTION_THREAD_STACK_SIZE);


/// Handles a client connection. Should run in its own thread.
static void handle_client(void *p1_client_socket, void *, void *) {
    int client_socket = reinterpret_cast<int>(p1_client_socket);
    LOG_INF("Handling socket: %d", client_socket);
    char message[] = "Hello, World!";

    // Send message to the client
    int sent = zsock_send(client_socket, message, sizeof(message) - 1, 0);
    LOG_INF("Sent: %d", sent);

    // Close the client socket
    int err = zsock_close(client_socket);
    if (err) {
        LOG_INF("Failed to close socket: %d", err);
    }
}

/// Opens a TCP server, listens for incoming clients, and spawns new threads to serve these connections. This function
/// blocks indefinitely.
int serve_connections() {
    LOG_INF("Opening socket");
    int server_socket = zsock_socket(AF_INET, SOCK_STREAM, IPPROTO_TCP);
    if (server_socket < 0) {
        LOG_ERR("Failed to create TCP socket: %d", errno);
        return 1;
    }

    sockaddr_in bind_addr = {};
    bind_addr.sin_family = AF_INET;
    bind_addr.sin_addr.s_addr = htonl(INADDR_ANY);
    bind_addr.sin_port = htons(19690);

    LOG_INF("Binding socket to address");
    int err = zsock_bind(server_socket, reinterpret_cast<sockaddr *>(&bind_addr), sizeof(bind_addr));
    if (err < 0) {
        LOG_ERR("Failed to bind to socket `%d`: %d", server_socket, err);
        return err;
    }
    LOG_INF("Listening for open connections");
    err = zsock_listen(server_socket, 4);
    if (err < 0) {
        LOG_ERR("Failed to listen on socket `%d`: %d", server_socket, err);
        return err;
    }

    // Serve new connections indefinitely
    while (true) {
        int client_socket = zsock_accept(server_socket, nullptr, nullptr);
        LOG_INF("Spawning thread to serve socket %d", client_socket);
        k_thread_create(&client_threads[next_open_connection],
                        reinterpret_cast<k_thread_stack_t *>(&client_stacks[next_open_connection]),
                        CONNECTION_THREAD_STACK_SIZE,
                        handle_client,
                        reinterpret_cast<void *>(client_socket), nullptr, nullptr, 5, 0, K_NO_WAIT
        );
        next_open_connection += 1;
        // TODO - reap dead threads
    }
}
```

## src/Server.h
```c
//
// Created by lpl on 10/23/25.
//

#ifndef APP_SERVER_H
#define APP_SERVER_H

int serve_connections();

#endif //APP_SERVER_H
```

## src/ThrottleValve.cpp
```c
//
// Created by lpl on 10/24/25.
//

#include "ThrottleValve.h"

#include <zephyr/device.h>
#include <zephyr/devicetree.h>
#include <zephyr/drivers/gpio.h>
#include <zephyr/kernel.h>
#include <zephyr/logging/log.h>

#define STEPPER0_NODE DT_NODELABEL(stepper0)
#define ZEPHYR_USER_NODE DT_PATH(zephyr_user)
static const struct gpio_dt_spec pul_gpios = GPIO_DT_SPEC_GET(DT_PATH(zephyr_user), stepper_pul_gpios);
static const struct gpio_dt_spec dir_gpios = GPIO_DT_SPEC_GET(DT_PATH(zephyr_user), stepper_dir_gpios);

LOG_MODULE_REGISTER(ThrottleValve, CONFIG_LOG_DEFAULT_LEVEL);

int throttle_valve_init() {
    // do some initializaiton work here?
    LOG_INF("Initializing throttle valve...");

    if (!device_is_ready(pul_gpios.port) || !device_is_ready(dir_gpios.port)) {
        LOG_ERR("GPIO device(s) not ready");
        return -ENODEV;
    }

    gpio_pin_configure_dt(&pul_gpios, GPIO_OUTPUT_INACTIVE);
    gpio_pin_configure_dt(&dir_gpios, GPIO_OUTPUT_INACTIVE);

    LOG_INF("Throttle valve initialized.");

    return 0;
}

int throttle_valve_start_calibrate() {
    LOG_INF("Imagine I am calibrating?");

    return 0;
}

int throttle_valve_move(double degrees, double timems) {
    LOG_INF("Move %f degrees over %f ms", degrees, timems);

    const double step_angle = 1.8;
    int steps = (int)(degrees / step_angle);
    if (steps < 0) steps = -steps;
    if (steps == 0) {
        LOG_INF("No movement requested");
        return 0;
    }

    /*
    // Set direction
    if (degrees > 0) {
        gpio_pin_set_dt(&dir_gpios, 1);
    } else {
        gpio_pin_set_dt(&dir_gpios, 0);
    }
    */

    // Calculate delay per pulse to complete in timems
    int delay_us = (int)((timems * 1000.0) / steps / 2); // divide by 2 for high+low
    if (delay_us < 5) {
        LOG_WRN("Requested move time too short, limiting delay to 5 us per microstep");
        delay_us = 5;
    }

    LOG_INF("Moving %d steps, %d us per half-step", steps, delay_us);

    for (int i = 0; i < steps; i++) {

        gpio_pin_set_dt(&pul_gpios, 1);
        k_busy_wait(delay_us);
        gpio_pin_set_dt(&pul_gpios, 0);
        k_busy_wait(delay_us);
    }

    LOG_INF("Movement complete");
    return 0;
}

int throttle_testing(){
    LOG_INF("Testing throttle valve movement...");
    double delay_us = 50; // 50 us
    int test_period_us = 5000000; // 5 seconds
    int steps = test_period_us/(2*delay_us); // Number of steps to run for 5 seconds
    gpio_pin_set_dt(&dir_gpios, 0); // Set initial direction
    k_busy_wait(delay_us);
    
    for (int i = 0; i < steps; i++) {
        gpio_pin_set_dt(&pul_gpios, 1);
        k_busy_wait(delay_us);
        gpio_pin_set_dt(&pul_gpios, 0);
        k_busy_wait(delay_us);

        if (i == steps/2) {
            gpio_pin_set_dt(&dir_gpios, 1); // Change direction after half time
            k_busy_wait(delay_us);
        }

    }

    LOG_INF("Test complete");
    return 0;
}
```

## src/ThrottleValve.h
```c
//
// Created by lpl on 10/24/25.
//

#ifndef CLOVER_THROTTLEVALVE_H
#define CLOVER_THROTTLEVALVE_H


int throttle_valve_init();

// some other functions here?
int throttle_valve_start_calibrate();

int throttle_valve_get_pos();
//throttle_valve_move(???);


#endif //CLOVER_THROTTLEVALVE_H
```

## src/sequencer.cpp
```c
//
// Created by lpl on 10/27/25.
//

#include "sequencer.h"
#include "throttle_valve.h"
#include "pts.h"
#include <vector>
#include <zephyr/logging/log.h>
#include <zephyr/kernel.h>
#include <zephyr/sys/util.h>
#include <array>
#include <string>
#include <zephyr/net/socket.h>
#include <sstream>

LOG_MODULE_REGISTER(sequencer, CONFIG_LOG_DEFAULT_LEVEL);

static constexpr int MAX_BREAKPOINTS = 20;

K_MUTEX_DEFINE(sequence_lock);
static int gap_millis;
static std::vector<float> breakpoints;
static int end_millis;

struct data_row {
    float time;
    float motor_pos;
    float pt203;
    float pt204;
    float ptf401;
};
static std::array<data_row, 4000> data_buffer;

int sequencer_start_trace(int sock, int gap, std::vector<float> bps) {
    if (bps.size() > MAX_BREAKPOINTS) {
        LOG_ERR("Too many breakpoints: %u", bps.size());
        return 1;
    }
    if (gap < 1) {
        LOG_ERR("Breakpoint gap is too short: %d ms", gap);
    }

    LOG_INF("Got breakpoints:");
    for (int i = 0; i < std::ssize(bps); ++i) {
        LOG_INF("t=%d ms, bp=%f", i * gap, static_cast<float>(bps[i]));
    }

//    int err = k_mutex_lock(&sequence_lock, K_NO_WAIT);
//    if(err)
//        if(err == -EBUSY) {
//            LOG_WRN("Tried starting trace, but one was already in progress.");
//        }
//        else {
//            LOG_ERR("Unexpected error while locking sequence_lock: err %d", err);
//        }
//        return err;
//    }
    end_millis = (std::ssize(bps) - 1) * gap;
    gap_millis = gap;
    breakpoints = bps;

    uint64_t start_time = k_cycle_get_64();
    for (int next_millis = 0; next_millis < end_millis; ++next_millis) {
        int low_bp_index = MIN(next_millis / gap_millis, std::ssize(breakpoints) - 1);
        int high_bp_index = low_bp_index + 1;
        if (low_bp_index < 0) {
            LOG_WRN("Low index is less than 0, how is that possible? curr: %d, gap: %d", next_millis, gap_millis);
            low_bp_index = 0;
        }
        float target;
        if (high_bp_index >= std::ssize(breakpoints)) {
            target = breakpoints.back();
        } else {
            float tween = static_cast<float>(next_millis - (low_bp_index * gap_millis)) / gap_millis;
            target = breakpoints[low_bp_index] + (breakpoints[high_bp_index] - breakpoints[low_bp_index]) * tween;
        }

        float curr_degrees = throttle_valve_get_pos();
        pt_readings readings = pts_sample();

        uint64_t since_start = k_cycle_get_64() - start_time;
        uint64_t ns_since_start = k_cyc_to_ns_floor64(since_start);
        data_buffer[next_millis] = data_row{
                .time = static_cast<float>(ns_since_start) / 1e9f, // to us lossy, then to sec
                .motor_pos = static_cast<float>(curr_degrees),
                .pt203 = static_cast<float>(readings.pt203),
                .pt204 = static_cast<float>(readings.pt204),
                .ptf401 = static_cast<float>(readings.ptf401)
        };


        // move to target
        throttle_valve_move(target, 0.001);
        k_sleep(K_MSEC(1));
    }
    throttle_valve_stop();

    {
        std::string line = "time,valve_pos,pt203,pt204,ptf401\n";
        int bytes_sent = 0;
        while (bytes_sent < std::ssize(line)) {
            int ret = zsock_send(sock, line.c_str() + bytes_sent, line.size() - bytes_sent, 0);
            if (ret < 0) {
                LOG_ERR("Failed to dump data: err %d", ret);
                return ret;
            }
            bytes_sent += ret;
        }
    }

    for (int i = 0; i < end_millis; ++i) {
        std::stringstream ss;
        ss.precision(8);
        ss << std::fixed << data_buffer[i].time << ',' << data_buffer[i].motor_pos << ',' << data_buffer[i].pt203 << ','
           << data_buffer[i].pt204
           << ',' << data_buffer[i].ptf401 << '\n';
        std::string line = ss.str();
        int bytes_sent = 0;
        while (bytes_sent < std::ssize(line)) {
            int ret = zsock_send(sock, line.c_str() + bytes_sent, line.size() - bytes_sent, 0);
            if (ret < 0) {
                LOG_ERR("Failed to dump data: err %d", ret);
                return ret;
            }
            bytes_sent += ret;
        }
    }

    return 0;
}
```

## src/sequencer.h
```c
#ifndef CLOVER_SEQUENCER_H
#define CLOVER_SEQUENCER_H

#include <vector>

int sequencer_start_trace(int sock, int gap, std::vector<float> bps);

#endif //CLOVER_SEQUENCER_H
```

## src/server.cpp
```c
#include <cctype>
#include <zephyr/logging/log.h>
#include <zephyr/net/socket.h>
#include <zephyr/sys/errno_private.h>
#include <zephyr/net/net_pkt.h>
#include <sstream>
#include <string>

#include "throttle_valve.h"
#include "server.h"
#include "guards/SocketGuard.h"
#include "pts.h"
#include "sequencer.h"


LOG_MODULE_REGISTER(Server, CONFIG_LOG_DEFAULT_LEVEL);

#define MAX_OPEN_CLIENTS 4

/// Main server thread must acquire one of these before accepting a connection. It must then scan through the thread
/// array to find an open slot.
K_SEM_DEFINE(num_open_connections, MAX_OPEN_CLIENTS, MAX_OPEN_CLIENTS);

bool has_thread[MAX_OPEN_CLIENTS] = {false};
K_MUTEX_DEFINE(has_thread_lock);

static k_thread client_threads[MAX_OPEN_CLIENTS] = {nullptr};
#define CONNECTION_THREAD_STACK_SIZE (4 * 1024)
K_THREAD_STACK_ARRAY_DEFINE(client_stacks, MAX_OPEN_CLIENTS, CONNECTION_THREAD_STACK_SIZE);

/// Helper that sends a payload completely through an socket
static int send_fully(int sock, const char *buf, int len) {
    int bytes_sent = 0;
    while (bytes_sent < len) {
        int ret = zsock_send(sock, buf + bytes_sent,
                             len - bytes_sent, 0);
        if (ret < 0) {
            LOG_ERR("Unexpected error while sending response: err %d", ret);
            return ret;
        }
        bytes_sent += ret;
    }
    return 0;
}

static int send_string_fully(int sock, const std::string &payload) {
    return send_fully(sock, payload.c_str(), std::ssize(payload));
}

/// Handles a client connection. Should run in its own thread.
static void handle_client(void *p1_client_socket, void *, void *) {
    SocketGuard client_guard{reinterpret_cast<int>(p1_client_socket)};
    LOG_INF("Handling socket: %d", client_guard.socket);
    k_sleep(K_MSEC(500));

    while (true) {
        // Read one byte at a time till we get a #-terminated command
        constexpr int MAX_COMMAND_LEN = 512;
        char command_buf[MAX_COMMAND_LEN + 1];
        int next_command_byte = 0;
        while (true) {
            ssize_t bytes_read = zsock_recv(client_guard.socket, command_buf + next_command_byte, 1, 0);
            if (bytes_read < 0) {
                LOG_WRN("Failed to read bytes: errno %d", errno);
                return;
            }
            if (bytes_read) {
                // Ignore whitespace
                if (std::isspace(command_buf[next_command_byte])) {
                    continue;
                }
                if (command_buf[next_command_byte] == '#') {
                    command_buf[next_command_byte + 1] = '\0';
                    break;
                }
            }
            next_command_byte += bytes_read;
            if (next_command_byte == MAX_COMMAND_LEN) {
                LOG_WRN("Didn't find command terminator `#` after %d bytes", MAX_COMMAND_LEN);
                return;
            }
        }

        LOG_INF("Got command: %s", command_buf);
        std::string command(command_buf); // TODO: Heap allocation? perhaps stick with annoying cstring?

        if (command == "calibrate#") {
            throttle_valve_start_calibrate();
            send_string_fully(client_guard.socket, "Done calibrating\n");
        } else if (command == "resetopen#") {
            // Sets the current position as 90 deg WITHOUT moving the valve.
            throttle_valve_set_open();
            send_string_fully(client_guard.socket, "Done reset open\n");
        } else if (command == "resetclose#") {
            // Sets the current position as 0 deg WITHOUT moving the valve.
            throttle_valve_set_closed();
            send_string_fully(client_guard.socket, "Done reset close\n");
        } else if (command.starts_with("seq")) {
            // Example: seq500;75.5,52.0,70,90, where 500 -> 500ms between each breakpoint and
            // the commas-seperated values are the breakpoints in degrees.
            // NOTE: An initial breakpoint, representing the valve current starting position,
            // is implicitly added. Thus, the example shown will run for 2s as we actually start
            // at, say, 90 deg.
            // Also, please do not give invalid input :) :) :)

            std::vector<float> seq_breakpoints;

            // Mini token parser
            int gap = 0;
            seq_breakpoints.clear();
            seq_breakpoints.push_back(throttle_valve_get_pos());
            bool wrote_gap = false;
            int curr_token = 0;
            for (int i = 3; i < std::ssize(command) - 1; ++i) {
                if (!(command[i] >= '0' && command[i] <= '9')) {
                    if (wrote_gap) {
                        seq_breakpoints.push_back(curr_token);
                    } else {
                        gap = curr_token;
                        wrote_gap = true;
                    }
                    curr_token = 0;
                } else {
                    curr_token = 10 * curr_token + (command[i] - '0');
                }
            }
            seq_breakpoints.push_back(curr_token);

            if (seq_breakpoints.size() <= 1) {
                send_string_fully(client_guard.socket, "Breakpoints too short\n");
                continue;
            }
            int time_ms = (std::ssize(seq_breakpoints) - 1) * gap;
            if (time_ms > 4000) {
                send_string_fully(client_guard.socket, "Sequence must be under 4000ms due to data storage cap\n");
                continue;
            }
            if (sequencer_prepare(gap, seq_breakpoints)) {
                send_string_fully(client_guard.socket, "Failed to prepare sequence");
                continue;
            }
            std::string msg = "Breakpoints prepared, length is: " + std::to_string(time_ms) + "ms\n";
            send_string_fully(client_guard.socket, msg.c_str());

        } else if (command == "getpos#") {
            double pos = throttle_valve_get_pos();
            std::string payload = "valve pos: " + std::to_string(pos) + " deg\n";
            int err = send_fully(client_guard.socket, payload.c_str(), std::ssize(payload));
            if (err) {
                LOG_ERR("Failed to fully send valve pos: err %d", err);
            }

        } else if (command == "getpts#") {
            pt_readings readings = pts_sample();
            std::string payload =
                    "pt203: " + std::to_string(readings.pt203) + ", pt204: " + std::to_string(readings.pt204) +
                    ", ptf401: " + std::to_string(readings.ptf401) + ", pt102: " + std::to_string(readings.pt102) +
                    "\n";
            int err = send_fully(client_guard.socket, payload.c_str(), std::ssize(payload));
            if (err) {
                LOG_ERR("Failed to fully send pt readings: err %d", err);
            }
        } else if (command == "START#" || command == "start#") {
            // Triggered in DAQ sequencer.
            send_string_fully(client_guard.socket, ">>>>SEQ START<<<<\n");
            int err = sequencer_start_trace(client_guard.socket);
            send_string_fully(client_guard.socket, ">>>>SEQ END<<<<\n");
            if (err) {
                LOG_ERR("Failed to run sequence: err %d", err);
                send_string_fully(client_guard.socket, "Failed to run sequence\n");
                continue;
            }

            send_string_fully(client_guard.socket, "Done sequence.\n");
        } else {
            LOG_WRN("Unknown command.");
        }
    }
}

/// Attempts to join connection handler threads, allowing the thread slots to be reused to service new connection.
[[noreturn]] static void reap_dead_connections(void *, void *, void *) {
    bool freed_threads[MAX_OPEN_CLIENTS] = {false};
    while (true) {
        k_mutex_lock(&has_thread_lock, K_FOREVER);
        for (int i = 0; i < MAX_OPEN_CLIENTS; ++i) {
            if (has_thread[i]) {
                int ret = k_thread_join(&client_threads[i], K_NO_WAIT);
                if (ret == 0) {
                    has_thread[i] = false;
                    freed_threads[i] = true;
                    k_sem_give(&num_open_connections);
                } else if (ret == -EBUSY) {
                    // Thread still running
                } else {
                    LOG_ERR("Unexpected code from joining client thread: err %d", ret);
                }
            }
        }
        k_mutex_unlock(&has_thread_lock);

        // Log freed threads outside mutex
        for (int i = 0; i < MAX_OPEN_CLIENTS; ++i) {
            if (freed_threads[i]) {
                LOG_INF("Freed thread at slot %d", i);
                freed_threads[i] = false;
            }
        }

        k_sleep(K_MSEC(50));
    }
}

K_THREAD_DEFINE(server_reaper, 1024, reap_dead_connections, nullptr, nullptr, nullptr, 1, 0, 0);


/// Opens a TCP server, listens for incoming clients, and spawns new threads to serve these connections. This function
/// blocks indefinitely.
void serve_connections() {
    LOG_INF("Opening socket");
    k_sleep(K_MSEC(500));
    LOG_INF("Opening socket");
    k_sleep(K_MSEC(500));
    int server_socket = zsock_socket(AF_INET, SOCK_STREAM, IPPROTO_TCP);
    if (server_socket < 0) {
        LOG_ERR("Failed to create TCP socket: %d", errno);
        return;
    }
    LOG_INF("HEY!");
    k_sleep(K_MSEC(500));

    sockaddr_in bind_addr = {};
    bind_addr.sin_family = AF_INET;
    bind_addr.sin_addr.s_addr = htonl(INADDR_ANY);
    bind_addr.sin_port = htons(19690);

    LOG_INF("Binding socket to address");
    int err = zsock_bind(server_socket, reinterpret_cast<sockaddr *>(&bind_addr), sizeof(bind_addr));
    if (err) {
        LOG_ERR("Failed to bind to socket `%d`: %d", server_socket, err);
        return;
    }
    LOG_INF("Listening for open connections");
    err = zsock_listen(server_socket, 0);
    if (err) {
        LOG_ERR("Failed to listen on socket `%d`: %d", server_socket, err);
        return;
    }

    // Serve new connections indefinitely
    while (true) {
        // Wait for free thread slot
        err = k_sem_take(&num_open_connections, K_FOREVER);
        if (err) {
            LOG_INF("Failed to acquire semaphore: %d", err);
            return;
        }

        // Find open connection index
        int connection_index = 0;
        k_mutex_lock(&has_thread_lock, K_FOREVER);
        for (connection_index = 0; connection_index < MAX_OPEN_CLIENTS; ++connection_index) {
            if (!has_thread[connection_index]) {
                break;
            }
        }
        k_mutex_unlock(&has_thread_lock);
        if (connection_index == MAX_OPEN_CLIENTS) {
            LOG_ERR("Consistency error: Server acquired connection semaphore but no thread slots were open");
            return;
        }

        // Spawn thread to service client connection
        int client_socket = zsock_accept(server_socket, nullptr, nullptr);
        LOG_INF("Spawning thread in slot %d to serve socket %d", connection_index, client_socket);
        k_thread_create(&client_threads[connection_index],
                        reinterpret_cast<k_thread_stack_t *>(&client_stacks[connection_index]),
                        CONNECTION_THREAD_STACK_SIZE,
                        handle_client,
                        reinterpret_cast<void *>(client_socket), nullptr, nullptr, 5, 0, K_NO_WAIT
        );

        k_mutex_lock(&has_thread_lock, K_FOREVER);
        has_thread[connection_index] = true;
        k_mutex_unlock(&has_thread_lock);
    }
}
```

## src/server.h
```c
//
// Created by lpl on 10/23/25.
//

#ifndef APP_SERVER_H
#define APP_SERVER_H

void serve_connections();

#endif //APP_SERVER_H
```

## src/servotesting.cpp
```c
#include "servotesting.h"

#include <zephyr/device.h>
#include <zephyr/devicetree.h>
#include <zephyr/kernel.h>
#include <zephyr/drivers/pwm.h>

#define ZEPHYR_USER_NODE DT_PATH(zephyr_user)


static const pwm_dt_spec ESC_1 =
    PWM_DT_SPEC_GET_BY_IDX(DT_PATH(zephyr_user), 0);
static const pwm_dt_spec ESC_2 =
    PWM_DT_SPEC_GET_BY_IDX(DT_PATH(zephyr_user), 1);


static const pwm_dt_spec SERVO_X =
    PWM_DT_SPEC_GET_BY_IDX(DT_PATH(zephyr_user), 2);
static const pwm_dt_spec SERVO_Y =
    PWM_DT_SPEC_GET_BY_IDX(DT_PATH(zephyr_user), 3);


static inline bool pwm_ready(const pwm_dt_spec& s) {
    return device_is_ready(s.dev);
}

/* Initialize: verify all PWM endpoints are present & ready */
int servos_init() {
    if (!pwm_ready(ESC_1) || !pwm_ready(ESC_2) ||
        !pwm_ready(SERVO_X) || !pwm_ready(SERVO_Y)) {
        return -ENODEV;
    }
    /* Optional: park outputs at neutral pulses if your PCA9685 default is 0 */
    pwm_set_pulse_dt(&SERVO_X, PWM_USEC(1500));
    pwm_set_pulse_dt(&SERVO_Y, PWM_USEC(1500));
    pwm_set_pulse_dt(&ESC_1,  PWM_USEC(1000)); // min/“disarmed”
    pwm_set_pulse_dt(&ESC_2,  PWM_USEC(1000));
    return 0;
}

/* Generic servo: degrees → microseconds → pwm_set_pulse_dt
   deg in [0,180] maps to [min_us,max_us] (defaults 1000–2000 µs) */
int servo_write_deg(const pwm_dt_spec& servo,
                    float deg,
                    uint16_t min_us = 1000,
                    uint16_t max_us = 2000)
{
    if (!pwm_ready(servo)) return -ENODEV;
    if (deg < 0.f)   deg = 0.f;
    if (deg > 180.f) deg = 180.f;
    const float span = float(max_us - min_us);
    const uint32_t us = uint32_t(min_us + (deg / 180.f) * span);
    return pwm_set_pulse_dt(&servo, PWM_USEC(us));
}

/* ESC helper: write a raw microsecond pulse (e.g., 1000–2000 µs) */
int esc_write_us(const pwm_dt_spec& esc, uint16_t us) {
    if (!pwm_ready(esc)) return -ENODEV;
    /* Clamp to something sane for hobby ESCs */
    if (us < 800)  us = 800;
    if (us > 2200) us = 2200;
    return pwm_set_pulse_dt(&esc, PWM_USEC(us));
}

/* Simple demo: sweep servos and blip ESCs */
int servotesting_demo() {
    printk("Servotesting demo\n");
    int err = servos_init();
    if (err) return err;

    /* Example: arm ESCs (typical: 1000 µs for a couple seconds) */
    esc_write_us(ESC_1, 1000);
    esc_write_us(ESC_2, 1000);
    k_msleep(2000);

    /* Optional: go to middle throttle */
    esc_write_us(ESC_1, 1500);
    esc_write_us(ESC_2, 1500);

    /* Sweep servos 0→180→0 */
    for (int d = 0; d <= 180; d += 5) {
        servo_write_deg(SERVO_X, d);
        servo_write_deg(SERVO_Y, 180 - d);
        k_msleep(20);
    }
    for (int d = 180; d >= 0; d -= 5) {
        servo_write_deg(SERVO_X, d);
        servo_write_deg(SERVO_Y, 180 - d);
        k_msleep(20);
    }

    /* Idle ESCs again */
    esc_idle();
    servo_neutral();
    return 0;
}

void servo_neutral() {
    servo_write_deg(SERVO_X, 90);
    servo_write_deg(SERVO_Y, 90);
}

void esc_idle() {
    esc_write_us(ESC_1, 1000);
    esc_write_us(ESC_2, 1000);

}
```

## src/servotesting.h
```c
#ifndef CLOVER_SERVOTESTING_H
#define CLOVER_SERVOTESTING_H


/* Simple arming/idle step for the ESCs (e.g., hold ~1000 µs). */
int servos_init();

/* Move both servos to target degrees over a time window (ms). */
int servo_write_deg(double servo_x_deg, double servo_y_deg, double timems);

/* Set raw throttle pulses for both ESCs in microseconds. */
int esc_write_us(int esc1_us, int esc2_us);

/* Quick bring-up routine: arm ESCs and sweep servos. */
int servotesting_demo();

/* Convenience presets. */
void servo_neutral();  /* servos ~90°, ESCs neutral if used */
void esc_idle();     /* ESCs ~1000 µs, servos unchanged   */

#endif // CLOVER_SERVOTESTING_H
```

## src/throttle_valve.cpp
```c
#include "throttle_valve.h"

#include <zephyr/device.h>
#include <zephyr/devicetree.h>
#include <zephyr/drivers/gpio.h>
#include <zephyr/kernel.h>
#include <zephyr/logging/log.h>

#define STEPPER0_NODE DT_NODELABEL(stepper0)
#define ZEPHYR_USER_NODE DT_PATH(zephyr_user)



static const struct gpio_dt_spec pul_gpios = GPIO_DT_SPEC_GET(DT_PATH(zephyr_user), stepper_pul_gpios);
static const struct gpio_dt_spec dir_gpios = GPIO_DT_SPEC_GET(DT_PATH(zephyr_user), stepper_dir_gpios);

LOG_MODULE_REGISTER(throttle_valve, CONFIG_LOG_DEFAULT_LEVEL);

constexpr int MICROSTEPS = 16;
constexpr double DEG_PER_STEP = 360.0 / 200.0 / 20.0 / static_cast<double>(MICROSTEPS);
volatile int steps = 0;

// Dir pin off = CCW with shaft facing up -> moves more open

int throttle_valve_init() {
    LOG_INF("Initializing throttle valve...");


    if (!device_is_ready(pul_gpios.port) || !device_is_ready(dir_gpios.port)) {
        LOG_ERR("GPIO device(s) not ready");
        return -ENODEV;
    }

    gpio_pin_configure_dt(&pul_gpios, GPIO_OUTPUT_INACTIVE);
    gpio_pin_configure_dt(&dir_gpios, GPIO_OUTPUT_INACTIVE);

    LOG_INF("Throttle valve initialized.");

    return 0;
}

int throttle_valve_start_calibrate() {
    LOG_INF("Beginning calibration.");

    int err = throttle_valve_move(105.0, 30000.0);
    if (err) {
        LOG_ERR("Move failed during calibration: err %d", err);
        return err;
    }
    steps = static_cast<int>(90.0 / DEG_PER_STEP);

    LOG_INF("Done initial movement. Backing off.");
    throttle_valve_move(-5.0, 500.0);

    LOG_INF("Calibrated to fully open.");
    return 0;
}

int throttle_valve_move(double delta_degrees, double timems) {
    int steps_to_move = static_cast<int>(delta_degrees / DEG_PER_STEP);
    if (steps_to_move < 0) steps_to_move = -steps_to_move;
    if (steps_to_move == 0) {
        k_busy_wait(1000*timems);
        return 0;
    }

    // Set direction
    if (delta_degrees > 0) {
        gpio_pin_set_dt(&dir_gpios, 1);
    } else {
        gpio_pin_set_dt(&dir_gpios, 0);
    }

    // Calculate delay per pulse to complete in timems
    int delay_us = (int) ((timems * 1000.0) / steps_to_move / 2); // divide by 2 for high+low
    if (delay_us < 5) {
        delay_us = 5;
    }

    for (int i = 0; i < steps_to_move; i++) {
        k_busy_wait(delay_us);
        gpio_pin_set_dt(&pul_gpios, 1);
        if (delta_degrees > 0) {
            steps += 1;
        } else {
            steps -= 1;
        }
        k_busy_wait(delay_us);
        gpio_pin_set_dt(&pul_gpios, 0);
    }

    return 0;
}

double throttle_valve_get_pos() {
    return static_cast<double>(steps) * DEG_PER_STEP;
}

int throttle_testing() {
    LOG_INF("Testing throttle valve movement...");
    double delay_us = 50; // 50 us
    int test_period_us = 5000000; // 5 seconds
    int steps = test_period_us / (2 * delay_us); // Number of steps to run for 5 seconds
    gpio_pin_set_dt(&dir_gpios, 0); // Set initial direction
    k_busy_wait(delay_us);

    for (int i = 0; i < steps; i++) {
        gpio_pin_set_dt(&pul_gpios, 1);
        k_busy_wait(delay_us);
        gpio_pin_set_dt(&pul_gpios, 0);
        k_busy_wait(delay_us);

        if (i == steps / 2) {
            gpio_pin_set_dt(&dir_gpios, 1); // Change direction after half time
            k_busy_wait(delay_us);
        }

    }

    LOG_INF("Test complete");
    return 0;
}

void throttle_valve_set_open() {
    steps = static_cast<int>(90.0 / DEG_PER_STEP);
}

void throttle_valve_set_closed() {
    steps = 0;
}
```
