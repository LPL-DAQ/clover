## CMakeLists.txt
```
#-------------------------------------------------------------------------------
# Zephyr Example Application
#
# Copyright (c) 2021 Nordic Semiconductor ASA
# SPDX-License-Identifier: Apache-2.0

cmake_minimum_required(VERSION 3.13.1)
find_package(Zephyr REQUIRED HINTS $ENV{ZEPHYR_BASE})

# For god's sake, why isn't this set automatically?
set(CMAKE_CPP_COMPILER "${CROSS_COMPILE}g++")
message(STATUS "C compiler: ${CMAKE_C_COMPILER}")
message(STATUS "C++ compiler: ${CMAKE_CPP_COMPILER}")

project(app)
add_subdirectory(src)
```

## prj.conf
```kconfig
# Copyright (c) 2021 Nordic Semiconductor ASA
# SPDX-License-Identifier: Apache-2.0
#
# This file contains selected Kconfig options for the application.

CONFIG_CPP=y
CONFIG_STD_CPP2B=y
CONFIG_SENSOR=y
CONFIG_BLINK=y
CONFIG_LOG_MODE_IMMEDIATE=y
CONFIG_REQUIRES_FULL_LIBC=y
CONFIG_GLIBCXX_LIBCPP=y
CONFIG_NEWLIB_LIBC=y
CONFIG_CBPRINTF_LIBC_SUBSTS=y

CONFIG_TIMESLICING=y
CONFIG_TIMESLICE_SIZE=10
CONFIG_TIMESLICE_PRIORITY=5

CONFIG_NETWORKING=y
CONFIG_NET_UDP=n
CONFIG_NET_TCP=y
CONFIG_NET_IPV4=y
CONFIG_INIT_STACKS=y
CONFIG_NET_LOG=y
CONFIG_NET_CONFIG_SETTINGS=y
CONFIG_NET_CONFIG_NEED_IPV4=y
# CONFIG_NET_CONFIG_MY_IPV4_ADDR="169.254.99.99"
CONFIG_NET_CONFIG_MY_IPV4_ADDR="192.168.0.150"
# CONFIG_NET_CONFIG_MY_IPV4_NETMASK="255.255.0.0"
CONFIG_NET_CONFIG_MY_IPV4_NETMASK="255.255.255.0"
CONFIG_NET_CONFIG_MY_IPV4_GW="192.168.0.1"
CONFIG_NET_L2_ETHERNET=y
CONFIG_NET_CONFIG_INIT_TIMEOUT=0
CONFIG_NET_CONTEXT_RCVTIMEO=y
CONFIG_NET_SOCKETS=y
CONFIG_NET_TX_STACK_SIZE=4096
CONFIG_NET_RX_STACK_SIZE=4096
CONFIG_SYSTEM_WORKQUEUE_STACK_SIZE=4096
CONFIG_NET_PKT_RX_COUNT=64
CONFIG_NET_PKT_TX_COUNT=64
CONFIG_NET_BUF_RX_COUNT=64
CONFIG_NET_BUF_TX_COUNT=64
CONFIG_NET_MAX_CONN=64
CONFIG_NET_MAX_CONTEXTS=64
CONFIG_NET_LOG=y
#CONFIG_NET_TCP_LOG_LEVEL_DBG=y
#CONFIG_NET_CONTEXT_LOG_LEVEL_DBG=y
#CONFIG_NET_SOCKETS_LOG_LEVEL_DBG=y
CONFIG_ADC=y
CONFIG_ADC_LOG_LEVEL_WRN=y

CONFIG_PWM=y
CONFIG_PWM_MCUX=y
CONFIG_PWM_LOG_LEVEL_DBG=y  
# CONFIG_PWM_LOG_LEVEL_ERR=y
# CONFIG_PWM_LOG_LEVEL_INF=y
# CONFIG_PWM_LOG_LEVEL_WRN=y


CONFIG_NET_CONNECTION_MANAGER=y

CONFIG_NET_TCP_TIME_WAIT_DELAY=0
```

## src/main.cpp
```c
#include <zephyr/kernel.h>
#include <zephyr/logging/log.h>
#include <zephyr/drivers/uart.h>
#include <zephyr/sys/util.h>
#include <zephyr/usb/usb_device.h>
#include <zephyr/net/net_if.h>
#include <zephyr/net/socket.h>
#include <zephyr/net/net_pkt.h>

#include "server.h"
#include "throttle_valve.h"
#include "pts.h"
#include "servotesting.h"

extern "C" {
#include <app/drivers/blink.h>
}

LOG_MODULE_REGISTER(main, CONFIG_LOG_DEFAULT_LEVEL);

BUILD_ASSERT(DT_NODE_HAS_COMPAT(DT_CHOSEN(zephyr_console), zephyr_cdc_acm_uart),
             "Console device is not ACM CDC UART device");

int main(void) {
    // Status LED
    const struct device *blink = DEVICE_DT_GET(DT_NODELABEL(blink_led));
    if (!device_is_ready(blink)) {
        return 0;
    }
    blink_set_period_ms(blink, 1000u);

    // Serial over USB setup
    if (usb_enable(nullptr)) {
        LOG_ERR("USB is not enabled.");
        while (1);
    }
    const struct device *usb_dev = DEVICE_DT_GET(DT_CHOSEN(zephyr_console));
    uint32_t dtr = 0;
    while (!dtr) {
        uart_line_ctrl_get(usb_dev, UART_LINE_CTRL_DTR, &dtr);
        k_sleep(K_MSEC(100));
    }

    LOG_INF("Initializing throttle valve");
    int err = throttle_valve_init();
    if (err) {
        LOG_ERR("Failed to initialize throttle valve");
        return 0;
    }

    LOG_INF("Initializing PTs");
    err = pts_init();
    if (err) {
        LOG_ERR("Failed to initialize PTs");
        return 0;
    }

    LOG_INF("Starting server");

    servotesting_demo();
    serve_connections();
    while (1);
}
```

## src/pts.cpp
```c
#include "pts.h"

#include <zephyr/sys/util.h>
#include <zephyr/drivers/adc.h>
#include <zephyr/logging/log.h>
#include <zephyr/kernel.h>

#define USER_NODE DT_PATH(zephyr_user)

// Validate devicetree
#if !DT_NODE_HAS_PROP(USER_NODE, pt_names)
#error "pts: Missing `pt-names` property from `zephyr-user` node."
#endif

#if !DT_NODE_HAS_PROP(USER_NODE, io_channels)
#error "pts: Missing `io-channels` property from `zephyr-user` node."
#endif

#if DT_PROP_LEN(USER_NODE, pt_names) != DT_PROP_LEN(USER_NODE, io_channels)
#error "pts: `pt-names` and `io-channels` must have the same length."
#endif

#define CONFIG_PT_SAMPLES 1


constexpr int NUM_PTS = DT_PROP_LEN(USER_NODE, io_channels);
// Trailing comma needed as we are using preprocessor to instantiate each element of an array.
#define CLOVER_PTS_DT_SPEC_AND_COMMA(node_id, prop, idx) ADC_DT_SPEC_GET_BY_IDX(node_id, idx),
static constexpr struct adc_dt_spec adc_channels[NUM_PTS] = {
        DT_FOREACH_PROP_ELEM(USER_NODE, io_channels, CLOVER_PTS_DT_SPEC_AND_COMMA)
};

static adc_sequence_options sequence_options = {
        .interval_us = 0,
        .extra_samplings = CONFIG_PT_SAMPLES - 1,
};
static adc_sequence sequence;
uint16_t raw_readings[CONFIG_PT_SAMPLES][NUM_PTS];

struct pt_config {
    float scale; // psig per analog reading unit. For teensy, resolution = 12, so for a 1k PT this would be (1000.0 / 4096.0)
    float bias;
};

pt_config configs[NUM_PTS] = {
        {
                .scale = 1000.0 / 4096.0,
                .bias = 0
        },
        {
                .scale = 1000.0 / 4096.0,
                .bias = 0
        },
        {
                .scale = 1000.0 / 4096.0,
                .bias = 0
        },
        {
                .scale = 1000.0 / 4096.0,
                .bias = 0
        },
};

LOG_MODULE_REGISTER(pts, CONFIG_LOG_DEFAULT_LEVEL);

/// Initialize PT sensors by initializing the ADC they're all connected to.
int pts_init() {
    // Initializes resolution and oversampling from device tree. Let's assume all channels share those properties. Also
    // initializes `channels` with just one channel, so we overwrite that later to sample all channels at once.
    LOG_INF("Initializing ADC sequence");
    adc_sequence_init_dt(&adc_channels[0], &sequence);
    sequence.buffer = raw_readings;
    sequence.buffer_size = sizeof raw_readings;
    sequence.options = &sequence_options;

    // Configure ADC channels.
    for (int i = 0; i < NUM_PTS; i++) {
        LOG_INF("pt %d: Checking readiness", i);
        if (!adc_is_ready_dt(&adc_channels[i])) {
            LOG_ERR("pt %d: ADC controller device %s not ready", i, adc_channels[i].dev->name);
            return 1;
        }

        LOG_INF("pt %d: Initializing channel", i);
        int err = adc_channel_setup_dt(&adc_channels[i]);
        if (err) {
            LOG_ERR("pt %d: Failed to set up channel: err %d", i, err);
            return 1;
        }

        // Request reading for this channel in sequence.
        sequence.channels |= BIT(adc_channels[i].channel_id);
    }

    return 0;
}

//int pts_configure(int pt_index, ) {
//
//}

/// Update PT sample readings.
pt_readings pts_sample() {
    int err = adc_read(adc_channels[0].dev, &sequence);
    if (err) {
        LOG_ERR("Failed to read from ADC: err %d", err);
        return pt_readings{};
    }

    // Averaging readings
    float readings_by_idx[NUM_PTS] = {0};
    for (int i = 0; i < NUM_PTS; ++i) {
        for (int j = 0; j < CONFIG_PT_SAMPLES; ++j) {
            readings_by_idx[i] += static_cast<float>(raw_readings[j][i]);
        }
        readings_by_idx[i] = readings_by_idx[i] / CONFIG_PT_SAMPLES * configs[i].scale + configs[i].bias;
    }

    // Assign each PT name as fields to initialize pt_readings
#define CLOVER_PTS_DT_TO_READINGS_ASSIGNMENT(node_id, prop, idx) .DT_STRING_TOKEN_BY_IDX(node_id, prop, idx) = readings_by_idx[idx],
    return pt_readings{
            DT_FOREACH_PROP_ELEM(USER_NODE, pt_names, CLOVER_PTS_DT_TO_READINGS_ASSIGNMENT)
    };
}

/// Log PT readings for debug purposes
void pts_log_readings(const pt_readings &readings) {
#define CLOVER_PTS_DT_TO_LOG(node_id, prop, idx) LOG_INF(DT_PROP_BY_IDX(node_id, prop, idx) ": %f psig", static_cast<double>(readings.DT_STRING_TOKEN_BY_IDX(node_id, prop, idx)));
    DT_FOREACH_PROP_ELEM(USER_NODE, pt_names, CLOVER_PTS_DT_TO_LOG)
}
```

## src/pts.h
```c
#ifndef CLOVER_PTS_H
#define CLOVER_PTS_H

#include <zephyr/devicetree.h>

/*
 * The following macro magic is used to generate a struct to hold the result of one PT reading. If the device tree has:
 *     ...
 *     names = "pt201", "pt202", "pt203", "pt204";
 *     io-channels = <&adc1 7>, <&adc1 8>, <&adc1 12>, <&adc1 11>;
 *     ...
 *
 * We will generate the following:
 * struct pt_readings {
 *     float pt201;
 *     float pt202;
 *     ...
 * }
 */

#define USER_NODE DT_PATH(zephyr_user)

#define CLOVER_PTS_DT_TO_READINGS_FIELD(node_id, prop, idx) float DT_STRING_TOKEN_BY_IDX(node_id, prop, idx);
struct pt_readings {
    DT_FOREACH_PROP_ELEM(USER_NODE, pt_names, CLOVER_PTS_DT_TO_READINGS_FIELD)
};

int pts_init();

pt_readings pts_sample();

void pts_log_readings(const pt_readings &readings);

#endif //CLOVER_PTS_H
```

## src/sequencer.cpp
```c
#include "sequencer.h"
#include "throttle_valve.h"
#include "pts.h"
#include <vector>
#include <zephyr/logging/log.h>
#include <zephyr/kernel.h>
#include <zephyr/sys/util.h>
#include <zephyr/sys/cbprintf.h>
#include <array>
#include <zephyr/net/socket.h>
#include <algorithm>
#include <string>
#include <cstdint>
#include "server.h"

LOG_MODULE_REGISTER(sequencer, CONFIG_LOG_DEFAULT_LEVEL);

constexpr uint64_t NSEC_PER_CONTROL_TICK = 1'000'000; // 1 ms

static constexpr int MAX_BREAKPOINTS = 20;

K_MUTEX_DEFINE(sequence_lock);

static int gap_millis;
static std::vector<float> breakpoints;
static int data_sock = -1;

volatile int step_count = 0;
volatile int count_to = 0;
uint64_t start_clock = 0;


/// Data that ought be logged for each control loop iteration.
struct control_iter_data {
    float time;
    uint32_t queue_size;
    float motor_target;
    float motor_pos;
    float motor_velocity;
    float motor_acceleration;
    uint64_t motor_nsec_per_pulse;
    float pt203;
    float pt204;
    float ptf401;
};

/// Control loop iteration will enqueue data for broadcasting over ethernet by another thread.
K_MSGQ_DEFINE(control_data_msgq, sizeof(control_iter_data), 100, 1);

/// Performs one iteration of the control loop. This must execute very quickly, so any physical actions or
/// interactions with peripherals should be asynchronous.
static void step_control_loop(k_work *) {
    // Last iter of control loop, execute cleanup tasks. step_count is [1, count_to] for normal iterations,
    // and step_count == count_to+1 for the last cleanup iteration.
    if (step_count > count_to) {
        throttle_valve_stop();
        // HACK: relinquish control for a little bit to allow client connection to flush data.
        // There really ought to be a cleaner way to do this.
        k_sleep(K_MSEC(100));
        k_msgq_purge(&control_data_msgq); // Signals client connection that no more
        return;
    }

    int next_millis = step_count + 1;

    int low_bp_index = MIN(next_millis / gap_millis, std::ssize(breakpoints) - 1);
    int high_bp_index = low_bp_index + 1;
    if (low_bp_index < 0) {
        LOG_WRN("Low index is less than 0, how is that possible? curr: %d, gap: %d", next_millis, gap_millis);
        low_bp_index = 0;
    }
    float target;
    if (high_bp_index >= std::ssize(breakpoints)) {
        target = breakpoints.back();
    } else {
        float tween = static_cast<float>(next_millis - (low_bp_index * gap_millis)) / gap_millis;
        target = breakpoints[low_bp_index] + (breakpoints[high_bp_index] - breakpoints[low_bp_index]) * tween;
    }


    // move to target
    throttle_valve_move(target);

    // Log current data
    // TODO - this copies :/ can we put the message in place?
    uint64_t since_start = k_cycle_get_64() - start_clock;
    uint64_t ns_since_start = k_cyc_to_ns_floor64(since_start);
    pt_readings readings = pts_sample();
    control_iter_data iter_data = {
            .time = static_cast<float>(ns_since_start) / 1e9f,
            .queue_size = k_msgq_num_used_get(&control_data_msgq),
            .motor_target = target,
            .motor_pos = throttle_valve_get_pos(),
            .motor_velocity = throttle_valve_get_velocity(),
            .motor_acceleration = throttle_valve_get_acceleration(),
            .motor_nsec_per_pulse = throttle_valve_get_nsec_per_pulse(),
            .pt203 = readings.pt203,
            .pt204 = readings.pt204,
            .ptf401 = readings.ptf401
    };
    int err = k_msgq_put(&control_data_msgq, &iter_data, K_NO_WAIT);
    if (err) {
        // Adding to msgq can only fail with -ENOMSG.
        LOG_ERR("Control data queue is full! Data is being lost!!!");
    }
}

K_WORK_DEFINE(control_loop, step_control_loop);

/// ISR that schedules a control iteration in the work queue.
static void control_loop_schedule(k_timer *timer) {
    // step_count is [0, count_to) during a normal iteration. step_count == count_to
    // schedules the final iteration.
    if (step_count > count_to) {
        k_msgq_purge(&control_data_msgq);
        k_timer_stop(timer);
        return;
    }
    k_work_submit(&control_loop);
    step_count += 1;
}

K_TIMER_DEFINE(control_loop_schedule_timer, control_loop_schedule, nullptr);

int sequencer_start_trace() {
    if (breakpoints.size() < 2) {
        LOG_ERR("No breakpoints specified.");
        return 1;
    }
    if (breakpoints.size() > MAX_BREAKPOINTS) {
        LOG_ERR("Too many breakpoints: %u", breakpoints.size());
        return 1;
    }
    if (gap_millis < 1) {
        LOG_ERR("Breakpoint gap_millis is too short: %d ms", gap_millis);
        return 1;
    }

    k_mutex_lock(&sequence_lock, K_FOREVER);
    if (data_sock == -1) {
        LOG_ERR("Data socket is not set");
        k_mutex_unlock(&sequence_lock);
        return 1;
    }


    // Replace first breakpoint with current position
    breakpoints.front() = throttle_valve_get_pos();
    LOG_INF("Got breakpoints:");
    for (int i = 0; i < std::ssize(breakpoints); ++i) {
        LOG_INF("t=%d ms, bp=%f", i * gap_millis, static_cast<double>(breakpoints[i]));
    }

    step_count = 0;
    count_to = (std::ssize(breakpoints) - 1) * gap_millis;

    start_clock = k_cycle_get_64();

    // Start control iterations
    k_timer_start(&control_loop_schedule_timer, K_NSEC(NSEC_PER_CONTROL_TICK), K_NSEC(NSEC_PER_CONTROL_TICK));

    // Print header
    send_string_fully(data_sock, ">>>>SEQ START<<<<\n");
    send_string_fully(data_sock,
                      "time,queue_size,motor_target,motor_pos,motor_velocity,motor_acceleration,motor_nsec_per_pulse,pt203,pt204,ptf401\n");

    // Dump data as we get it. Connection client is preemptible while control sequence is in system workqueue
    // (cooperative) so sending data should never block processing of control iter.
    control_iter_data data = {0};
    while (true) {
        int err = k_msgq_get(&control_data_msgq, &data, K_FOREVER);
        // -ENOMSG is sent when queue is purged to signal end of control seq. No other possible
        // error as we are waiting forever.
        if (err) {
            break;
        }

        constexpr int MAX_DATA_LEN = 512;
        char buf[MAX_DATA_LEN];

        int would_write = snprintfcb(buf, MAX_DATA_LEN, "%.8f,%d,%.8f,%.8f,%.8f,%.8f,%llu,%.8f,%.8f,%.8f\n",
                                     static_cast<double>(data.time),
                                     data.queue_size,
                                     static_cast<double>(data.motor_target), static_cast<double>(data.motor_pos),
                                     static_cast<double>(data.motor_velocity),
                                     static_cast<double>(data.motor_acceleration),
                                     data.motor_nsec_per_pulse,
                                     static_cast<double>(data.pt203),
                                     static_cast<double>(data.pt204), static_cast<double>(data.ptf401));
        // snprintfcb's would_write excludes null byte, but max via MAX_DATA_LEN would include null byte.
        int actually_written = std::min(would_write, MAX_DATA_LEN - 1);
        err = send_fully(data_sock, buf, actually_written);
        if (err) {
            LOG_WRN("Failed to send data");
        }
    }

    send_string_fully(data_sock, ">>>>SEQ END<<<<\n");

    // Next data recipient should be explicitly re-set.
    data_sock = -1;
    k_mutex_unlock(&sequence_lock);
    return 0;
}

int sequencer_prepare(int gap, std::vector<float> bps) {
    if (gap <= 0 || bps.empty()) {
        return 1;
    }

    gap_millis = gap;
    breakpoints = bps;
    return 0;
}

void sequencer_set_data_recipient(int sock) {
    k_mutex_lock(&sequence_lock, K_FOREVER);
    data_sock = sock;
    k_mutex_unlock(&sequence_lock);
}
```

## src/sequencer.h
```c
#ifndef CLOVER_SEQUENCER_H
#define CLOVER_SEQUENCER_H

#include <vector>

int sequencer_prepare(int gap, std::vector<float> bps);

int sequencer_start_trace();

void sequencer_set_data_recipient(int sock);

#endif //CLOVER_SEQUENCER_H
```

## src/server.cpp
```c
#include <cctype>
#include <zephyr/logging/log.h>
#include <zephyr/net/socket.h>
#include <zephyr/sys/errno_private.h>
#include <zephyr/net/net_pkt.h>
#include <sstream>
#include <string>
#include <array>

#include "throttle_valve.h"
#include "server.h"
#include "guards/SocketGuard.h"
#include "pts.h"
#include "sequencer.h"


LOG_MODULE_REGISTER(Server, CONFIG_LOG_DEFAULT_LEVEL);

#define MAX_OPEN_CLIENTS 4

/// Main server thread must acquire one of these before accepting a connection. It must then scan through the thread
/// array to find an open slot.
K_SEM_DEFINE(num_open_connections, MAX_OPEN_CLIENTS, MAX_OPEN_CLIENTS);

bool has_thread[MAX_OPEN_CLIENTS] = {false};
K_MUTEX_DEFINE(has_thread_lock);

static k_thread client_threads[MAX_OPEN_CLIENTS] = {nullptr};
#define CONNECTION_THREAD_STACK_SIZE (4 * 1024)
K_THREAD_STACK_ARRAY_DEFINE(client_stacks, MAX_OPEN_CLIENTS, CONNECTION_THREAD_STACK_SIZE);

/// Helper that sends a payload completely through an socket
int send_fully(int sock, const char *buf, int len) {
    int bytes_sent = 0;
    while (bytes_sent < len) {
        int ret = zsock_send(sock, buf + bytes_sent,
                             len - bytes_sent, 0);
        if (ret < 0) {
            LOG_ERR("Unexpected error while sending response: err %d", ret);
            return ret;
        }
        bytes_sent += ret;
    }
    return 0;
}

int send_string_fully(int sock, const std::string &payload) {
    return send_fully(sock, payload.c_str(), std::ssize(payload));
}

/// Handles a client connection. Should run in its own thread.
static void handle_client(void *p1_client_socket, void *, void *) {
    SocketGuard client_guard{reinterpret_cast<int>(p1_client_socket)};
    LOG_INF("Handling socket: %d", client_guard.socket);
    k_sleep(K_MSEC(500));

    while (true) {
        // Read one byte at a time till we get a #-terminated command
        constexpr int MAX_COMMAND_LEN = 512;
        char command_buf[MAX_COMMAND_LEN + 1];
        int next_command_byte = 0;
        while (true) {
            ssize_t bytes_read = zsock_recv(client_guard.socket, command_buf + next_command_byte, 1, 0);
            if (bytes_read < 0) {
                LOG_WRN("Failed to read bytes: errno %d", errno);
                return;
            }
            if (bytes_read) {
                // Ignore whitespace
                if (std::isspace(command_buf[next_command_byte])) {
                    continue;
                }
                if (command_buf[next_command_byte] == '#') {
                    command_buf[next_command_byte + 1] = '\0';
                    break;
                }
            }
            next_command_byte += bytes_read;
            if (next_command_byte == MAX_COMMAND_LEN) {
                LOG_WRN("Didn't find command terminator `#` after %d bytes", MAX_COMMAND_LEN);
                return;
            }
        }

        LOG_INF("Got command: %s", command_buf);
        std::string command(command_buf); // TODO: Heap allocation? perhaps stick with annoying cstring?

        if (command == "calibrate#") {
            throttle_valve_start_calibrate();
            send_string_fully(client_guard.socket, "Done calibrating\n");
        } else if (command == "resetopen#") {
            // Sets the current position as 90 deg WITHOUT moving the valve.
            throttle_valve_set_open();
            send_string_fully(client_guard.socket, "Done reset open\n");
        } else if (command == "resetclose#") {
            // Sets the current position as 0 deg WITHOUT moving the valve.
            throttle_valve_set_closed();
            send_string_fully(client_guard.socket, "Done reset close\n");
        } else if (command.starts_with("seq")) {
            // Example: seq500;75.5,52.0,70,90, where 500 -> 500ms between each breakpoint and
            // the commas-seperated values are the breakpoints in degrees.
            // NOTE: An initial breakpoint, representing the valve current starting position,
            // is implicitly added. Thus, the example shown will run for 2s as we actually start
            // at, say, 90 deg.
            // Also, please do not give invalid input :) :) :)

            std::vector<float> seq_breakpoints;

            // Mini token parser
            int gap = 0;
            seq_breakpoints.clear();
            seq_breakpoints.push_back(throttle_valve_get_pos());
            bool wrote_gap = false;
            int curr_token = 0;
            bool is_neg = false;
            for (int i = 3; i < std::ssize(command) - 1; ++i) {
                if (!(command[i] >= '0' && command[i] <= '9')) {
                    if (command[i] == '-') {
                        is_neg = true;
                    } else if (wrote_gap) {
                        if (is_neg) {
                            curr_token = -curr_token;
                        }
                        seq_breakpoints.push_back(curr_token);
                        is_neg = false;
                    } else {
                        gap = curr_token;
                        wrote_gap = true;
                    }
                    curr_token = 0;
                } else {
                    curr_token = 10 * curr_token + (command[i] - '0');
                }
            }
            if (is_neg) {
                curr_token = -curr_token;
            }
            seq_breakpoints.push_back(curr_token);
            is_neg = false;

            if (seq_breakpoints.size() <= 1) {
                send_string_fully(client_guard.socket, "Breakpoints too short\n");
                continue;
            }
            int time_ms = (std::ssize(seq_breakpoints) - 1) * gap;
            if (sequencer_prepare(gap, seq_breakpoints)) {
                send_string_fully(client_guard.socket, "Failed to prepare sequence");
                continue;
            }
            std::string msg = "Breakpoints prepared, length is: " + std::to_string(time_ms) + "ms\n";
            send_string_fully(client_guard.socket, msg.c_str());

        } else if (command == "getpos#") {
            double pos = throttle_valve_get_pos();
            std::string payload = "valve pos: " + std::to_string(pos) + " deg\n";
            int err = send_fully(client_guard.socket, payload.c_str(), std::ssize(payload));
            if (err) {
                LOG_ERR("Failed to fully send valve pos: err %d", err);
            }

        } else if (command == "getpts#") {
            pt_readings readings = pts_sample();
            std::string payload =
                    "pt203: " + std::to_string(readings.pt203) + ", pt202: " + std::to_string(readings.pt203) +
                    ", ptf401: " + std::to_string(readings.ptf401) + ", pt102: " + std::to_string(readings.pt102) +
                    "\n";
            int err = send_fully(client_guard.socket, payload.c_str(), std::ssize(payload));
            if (err) {
                LOG_ERR("Failed to fully send pt readings: err %d", err);
            }
        } else if (command == "START#") {
            send_string_fully(client_guard.socket, "ACK#");
            // Triggered in DAQ sequencer.
            LOG_INF("Triggering sequence from DAQ.");
            int err = sequencer_start_trace();
            if (err) {
                LOG_ERR("Failed to run sequence: err %d", err);
                continue;
            }
        } else if (command == "listen#") {
            send_string_fully(client_guard.socket,
                              "Don't send additional commands till the sequence is done, lest the output be mangled.\n");
            send_string_fully(client_guard.socket, "Listening for sequence...\n");
            sequencer_set_data_recipient(client_guard.socket);
        } else if (command == "dstart#") {
            // Triggered manually.
            sequencer_set_data_recipient(client_guard.socket);
            int err = sequencer_start_trace();
            if (err) {
                LOG_ERR("Failed to run sequence: err %d", err);
                send_string_fully(client_guard.socket, "Failed to run sequence\n");
                continue;
            }
            send_string_fully(client_guard.socket, "Done sequence.\n");
        } else if (command.starts_with("configpt")) {
            // Configure the pt bias as such:
            // configptbias,pt203,-5#
            // Or set the PT range (e.g., 1k PT) as such:
            // configptrang,pt203,2000#

            bool config_bias_not_range = false;
            std::string config_what = command.substr(8, 4);
            if (config_what == "bias") {
                config_bias_not_range = true;
            } else if (config_what == "rang") {
                config_bias_not_range = false;
            } else {
                LOG_ERR("Invalid config option for PT");
                continue;
            }

            std::string pt_name;
            float value = 0;
            bool bias_is_negative = false;
            bool in_label_segment = true;
            for (int i = 12; i < std::ssize(command); ++i) {
                if (command[i] != ',') {
                    if (in_label_segment) {
                        pt_name += command[i];
                    } else {
                        if (command[i] == '-') {
                            bias_is_negative = true;
                        } else {
                            value = value * 10.0f + static_cast<float>(command[i] - '0');
                        }
                    }
                } else {
                    in_label_segment = false;
                }
            }
            if (bias_is_negative) {
                value *= -1;
            }

            int pt_index = -1;
            if (pt_name == "pt202") {
                pt_index = 1;
            } else if (pt_name == "pt203") {
                pt_index = 2;
            } else if (pt_name == "ptf401") {
                pt_index = 3;
            } else {
                LOG_ERR("Invalid pt name: %s", pt_name.c_str());
                continue;
            }

            int err = 0;
            if (config_bias_not_range) {
                err = pts_set_bias(pt_index, value);
            } else {
                err = pts_set_range(pt_index, value);
            }
            if (err) {
                LOG_ERR("Failed to set PT bias: err %d", err);
                continue;
            }

            send_string_fully(client_guard.socket, "Set PT bias.");
        } else if (command == "getptconfigs") {
            std::string payload;
            std::array<std::string, 4> index_to_pt{
                    "UNUSED",
                    "pt202",
                    "pt203",
                    "ptf401"
            };
            for (int i = 1; i < 4; ++i) {
                payload += index_to_pt[i] + ": bias=" + std::to_string(pt_configs[i].bias) + "psig, range=" +
                           std::to_string(pt_configs[i].range) + "psig\n";
            }
            send_string_fully(client_guard.socket, payload);
        } else {
            LOG_WRN("Unknown command.");
        }
    }
}

/// Attempts to join connection handler threads, allowing the thread slots to be reused to service new connection.
[[noreturn]] static void reap_dead_connections(void *, void *, void *) {
    bool freed_threads[MAX_OPEN_CLIENTS] = {false};
    while (true) {
        k_mutex_lock(&has_thread_lock, K_FOREVER);
        for (int i = 0; i < MAX_OPEN_CLIENTS; ++i) {
            if (has_thread[i]) {
                int ret = k_thread_join(&client_threads[i], K_NO_WAIT);
                if (ret == 0) {
                    has_thread[i] = false;
                    freed_threads[i] = true;
                    k_sem_give(&num_open_connections);
                } else if (ret == -EBUSY) {
                    // Thread still running
                } else {
                    LOG_ERR("Unexpected code from joining client thread: err %d", ret);
                }
            }
        }
        k_mutex_unlock(&has_thread_lock);

        // Log freed threads outside mutex
        for (int i = 0; i < MAX_OPEN_CLIENTS; ++i) {
            if (freed_threads[i]) {
                LOG_INF("Freed thread at slot %d", i);
                freed_threads[i] = false;
            }
        }

        k_sleep(K_MSEC(50));
    }
}

K_THREAD_DEFINE(server_reaper, 1024, reap_dead_connections, nullptr, nullptr, nullptr, 1, 0, 0);


/// Opens a TCP server, listens for incoming clients, and spawns new threads to serve these connections. This function
/// blocks indefinitely.
void serve_connections() {
    LOG_INF("Opening socket");
    k_sleep(K_MSEC(500));
    LOG_INF("Opening socket");
    k_sleep(K_MSEC(500));
    int server_socket = zsock_socket(AF_INET, SOCK_STREAM, IPPROTO_TCP);
    if (server_socket < 0) {
        LOG_ERR("Failed to create TCP socket: %d", errno);
        return;
    }
    LOG_INF("HEY!");
    k_sleep(K_MSEC(500));

    sockaddr_in bind_addr = {};
    bind_addr.sin_family = AF_INET;
    bind_addr.sin_addr.s_addr = htonl(INADDR_ANY);
    bind_addr.sin_port = htons(19690);

    LOG_INF("Binding socket to address");
    int err = zsock_bind(server_socket, reinterpret_cast<sockaddr *>(&bind_addr), sizeof(bind_addr));
    if (err) {
        LOG_ERR("Failed to bind to socket `%d`: %d", server_socket, err);
        return;
    }
    LOG_INF("Listening for open connections");
    err = zsock_listen(server_socket, 0);
    if (err) {
        LOG_ERR("Failed to listen on socket `%d`: %d", server_socket, err);
        return;
    }

    // Serve new connections indefinitely
    while (true) {
        // Wait for free thread slot
        err = k_sem_take(&num_open_connections, K_FOREVER);
        if (err) {
            LOG_INF("Failed to acquire semaphore: %d", err);
            return;
        }

        // Find open connection index
        int connection_index = 0;
        k_mutex_lock(&has_thread_lock, K_FOREVER);
        for (connection_index = 0; connection_index < MAX_OPEN_CLIENTS; ++connection_index) {
            if (!has_thread[connection_index]) {
                break;
            }
        }
        k_mutex_unlock(&has_thread_lock);
        if (connection_index == MAX_OPEN_CLIENTS) {
            LOG_ERR("Consistency error: Server acquired connection semaphore but no thread slots were open");
            return;
        }

        // Spawn thread to service client connection
        int client_socket = zsock_accept(server_socket, nullptr, nullptr);
        LOG_INF("Spawning thread in slot %d to serve socket %d", connection_index, client_socket);
        k_thread_create(&client_threads[connection_index],
                        reinterpret_cast<k_thread_stack_t *>(&client_stacks[connection_index]),
                        CONNECTION_THREAD_STACK_SIZE,
                        handle_client,
                        reinterpret_cast<void *>(client_socket), nullptr, nullptr, 5, 0, K_NO_WAIT
        );

        k_mutex_lock(&has_thread_lock, K_FOREVER);
        has_thread[connection_index] = true;
        k_mutex_unlock(&has_thread_lock);
    }
}
```

## src/server.h
```c
#ifndef CLOVER_SERVER_H
#define CLOVER_SERVER_H

void serve_connections();

int send_fully(int sock, const char *buf, int len);

#endif //CLOVER_SERVER_H
```

## src/servotesting.cpp
```c
#include "servotesting.h"

#include <zephyr/logging/log.h>
#include <zephyr/device.h>
#include <zephyr/devicetree.h>
#include <zephyr/kernel.h>
#include <zephyr/drivers/pwm.h>

#define ZEPHYR_USER_NODE DT_PATH(zephyr_user)

LOG_MODULE_REGISTER(servotesting, CONFIG_LOG_DEFAULT_LEVEL);


// start with 1000-2000 us PWM signal, test to go up to 500-2500
static const pwm_dt_spec SERVO_X =
    PWM_DT_SPEC_GET_BY_NAME(DT_PATH(zephyr_user), tvc_x);

static const pwm_dt_spec SERVO_Y =
    PWM_DT_SPEC_GET_BY_NAME(DT_PATH(zephyr_user), tvc_y);

static const pwm_dt_spec ESC_2 =
    PWM_DT_SPEC_GET_BY_NAME(DT_PATH(zephyr_user), esc_2);



static inline bool pwm_ready(const pwm_dt_spec& s) {
    return device_is_ready(s.dev);
}

/* Initialize: verify all PWM endpoints are present & ready */
int servos_init() {
    if (!pwm_ready(ESC_2) ||
        !pwm_ready(SERVO_X) || !pwm_ready(SERVO_Y)) {
        return -ENODEV;
    }
    /* Optional: park outputs at neutral pulses if your PCA9685 default is 0 */
    pwm_set_pulse_dt(&SERVO_X, PWM_USEC(1500));
    pwm_set_pulse_dt(&SERVO_Y, PWM_USEC(1500));
    pwm_set_pulse_dt(&ESC_2,  PWM_USEC(1000));
    return 0;
}

/* Generic servo: degrees → microseconds → pwm_set_pulse_dt
   deg in [0,180] maps to [min_us,max_us] (defaults 1000–2000 µs) */
int servo_write_deg(const pwm_dt_spec& servo,
                    float deg,
                    uint16_t min_us,
                    uint16_t max_us)
{
    if (!pwm_ready(servo)) return -ENODEV;
    if (deg < 0.f)   deg = 0.f;
    if (deg > 180.f) deg = 180.f;
    const float span = float(max_us - min_us);
    const uint32_t us = uint32_t(min_us + (deg / 180.f) * span);
    return pwm_set_pulse_dt(&servo, PWM_USEC(us));
}

/* ESC helper: write a raw microsecond pulse (e.g., 1000–2000 µs) */
int esc_write_us(const pwm_dt_spec& esc, uint16_t us) {
    if (!pwm_ready(esc)) return -ENODEV;
    /* Clamp to something sane for hobby ESCs */
    if (us < 800)  us = 800;
    if (us > 2200) us = 2200;
    return pwm_set_pulse_dt(&esc, PWM_USEC(us));
}

/* Simple demo: sweep servos and blip ESCs */
int servotesting_demo() {
    printk("Servotesting demo\n");
    int err = servos_init();
    if (err) return err;

    printk("arm esc\n");

    /* Example: arm ESCs (typical: 1000 µs for a couple seconds) */
    esc_write_us(ESC_2, 1000);
    k_msleep(1000);

    printk("middle throttle\n");
    esc_write_us(ESC_2, 1500);
    k_msleep(1500);

    printk("servo 0 -> 180 \n");
    /* servos 90 */
    while (true){

    for (int d = 0; d <= 180; d += 2) {

        int err = 0;
        err = servo_write_deg(SERVO_X, d);
        if (err) {
            LOG_ERR("Failed to write servo X");
            return 0;
        }

        err = servo_write_deg(SERVO_Y, d);
        if (err) {
            LOG_ERR("Failed to write servo Y");
            return 0;
        }
        k_msleep(20);
    }
    printk("servo 180 -> 0 \n");

    /* servos 90 */
    for (int d = 0; d <= 180; d += 2) {

        int err = 0;
        err = servo_write_deg(SERVO_X, 180-d);
        err = servo_write_deg(SERVO_Y, 180-d);
        if (err) {
            LOG_ERR("Failed to write servo X");
            return 0;
        }

        if (err) {
            LOG_ERR("Failed to write servo Y");
            return 0;
        }
        k_msleep(20);
    }
    }

    printk("demo over: idle all\n");

    /* Idle ESCs again */
    esc_idle();
    servo_neutral();
    return 0;
}

void servo_neutral() {
    servo_write_deg(SERVO_X, 90);
    servo_write_deg(SERVO_Y, 90);
}

void esc_idle() {
    esc_write_us(ESC_2, 1000);

}
```

## src/throttle_valve.cpp
```c
#include "throttle_valve.h"

#include <zephyr/device.h>
#include <zephyr/devicetree.h>
#include <zephyr/drivers/gpio.h>
#include <zephyr/drivers/counter.h>
#include <zephyr/kernel.h>
#include <zephyr/logging/log.h>
#include <zephyr/sys/util.h>
#include <cmath>
#include <algorithm>

static const struct gpio_dt_spec pul_gpio = GPIO_DT_SPEC_GET(DT_PATH(zephyr_user), stepper_pul_gpios);
static const struct gpio_dt_spec dir_gpio = GPIO_DT_SPEC_GET(DT_PATH(zephyr_user), stepper_dir_gpios);

/// Timer for delivering pulses to driver
static const struct device *stepper_pulse_counter_dev = DEVICE_DT_GET(DT_ALIAS(stepper_pulse_counter));
constexpr int COUNTER_CHANNEL = 0;
volatile uint32_t pulse_counter_ticks = 0;

LOG_MODULE_REGISTER(throttle_valve, CONFIG_LOG_DEFAULT_LEVEL);

constexpr float MICROSTEPS = 8.0f;
constexpr float GEARBOX_RATIO = 20.0f;
constexpr float STEPS_PER_REVOLUTION = 200.0f;
constexpr float DEG_PER_STEP = 360.0f / STEPS_PER_REVOLUTION / GEARBOX_RATIO / MICROSTEPS;

constexpr float MAX_VELOCITY = 225.0f; // In deg/s
constexpr float MAX_ACCELERATION = 12000.0f; // In deg/s^2


enum MotorState {
    STOPPED,
    RUNNING,
};
static MotorState state = STOPPED;

volatile static int steps = 0;
static float velocity = 0;
static float acceleration = 0;
static volatile uint64_t last_time = 0;
static volatile uint64_t true_interval = 0;
K_MUTEX_DEFINE(motor_lock);


/// Directly controls signal to controller, each rising edge on PUL is one step.
static void pulse(const struct device *, uint8_t, uint32_t, void *) {
    // Schedule next pulse
    int err = counter_cancel_channel_alarm(stepper_pulse_counter_dev, COUNTER_CHANNEL);
    if (err) {
        LOG_ERR("Failed to cancel current stepper pulse counter channel alarm: err %d", err);
    }
    const counter_alarm_cfg pulse_counter_cfg = {
            .callback = pulse,
            .ticks = pulse_counter_ticks,
            .user_data = nullptr,
            .flags = 0
    };
    err = counter_set_channel_alarm(stepper_pulse_counter_dev, COUNTER_CHANNEL, &pulse_counter_cfg);
    if (err) {
        LOG_ERR("Failed to set counter top: err %d", err);
    }

    uint64_t now = k_cycle_get_64();
    true_interval = now - last_time;
    last_time = now;

    // Switch direction, if we must.
    // gpio high -> flipped by converter to low -> more open.
    // pgio low -> flipped by converter to high -> more close.
    if ((gpio_pin_get_dt(&dir_gpio) == 1 && velocity > 0) || (!gpio_pin_get_dt(&dir_gpio) && velocity < 0)) {
        gpio_pin_toggle_dt(&dir_gpio);
        // We need to wait a while after changing dir before for next pulses.
        return;
    }
    // high to low -> flipped by converter to low to high -> rising edge, count a step.
    if (gpio_pin_get_dt(&pul_gpio)) {
        if (gpio_pin_get_dt(&dir_gpio)) {
            steps -= 1;
        } else {
            steps += 1;
        }
    }
    gpio_pin_toggle_dt(&pul_gpio);
}

/// Initializes throttle valve driver.
int throttle_valve_init() {
    LOG_INF("Initializing throttle valve...");

    if (!device_is_ready(pul_gpio.port) || !device_is_ready(dir_gpio.port)) {
        LOG_ERR("GPIO device(s) not ready");
        return -ENODEV;
    }

    gpio_pin_configure_dt(&pul_gpio, GPIO_OUTPUT_INACTIVE);
    gpio_pin_configure_dt(&dir_gpio, GPIO_OUTPUT_INACTIVE);

    if (!device_is_ready(stepper_pulse_counter_dev)) {
        LOG_ERR("Stepper timer device is not ready.");
        return 1;
    }

    LOG_INF("Throttle valve initialized.");

    return 0;
}

int throttle_valve_start_calibrate() {
    LOG_INF("Beginning calibration.");
//
//    int err = throttle_valve_move(105.0f, 30.0f);
//    if (err) {
//        LOG_ERR("Move failed during calibration: err %d", err);
//        return err;
//    }
//    steps = static_cast<int>(90.0f / DEG_PER_STEP);
//
//    LOG_INF("Done initial movement. Backing off.");
//    throttle_valve_move(-5.0f, 0.5f);
//
//    LOG_INF("Calibrated to fully open.");
    return 0;
}

/// Moves to a certain degree position within the specified time. Does not necessarily guarantee that this will happen
/// as speed and acceleration limits will be enforced, but it is what we will target.
void throttle_valve_move(float target_deg) {
    constexpr float CONTROL_TIME = 0.001;

    float target_velocity = (target_deg - throttle_valve_get_pos()) / CONTROL_TIME;

    // If target velocity would require excessive acceleration, clamp it.
    float required_acceleration = (target_velocity - velocity) / CONTROL_TIME;
    if (required_acceleration > MAX_ACCELERATION) {
        target_velocity = velocity + CONTROL_TIME * MAX_ACCELERATION;
    } else if (required_acceleration < -MAX_ACCELERATION) {
        target_velocity = velocity - CONTROL_TIME * MAX_ACCELERATION;
    }

    // Clamp velocity
    target_velocity = std::clamp(target_velocity, -MAX_VELOCITY, MAX_VELOCITY);

    // Based on velocity, calculate pulse interval. Must divide by two as each counter trigger
    // only toggles pulse, so two triggers are needed for full step on rising edge.
    auto usec_per_pulse = static_cast<uint64_t>(1e6 / static_cast<double>(std::abs(target_velocity)) *
                                                static_cast<double>(DEG_PER_STEP) / 2.0);

    // Set true values for acceleration and velocity.
    acceleration = (target_velocity - velocity) / CONTROL_TIME;
    velocity = target_velocity;

    // Ensure timer is running
    counter_start(stepper_pulse_counter_dev);

    // Halt current pulse counter.
    int err = counter_cancel_channel_alarm(stepper_pulse_counter_dev, COUNTER_CHANNEL);
    if (err) {
        LOG_ERR("Failed to cancel current stepper pulse counter channel alarm: err %d", err);
    }

    // Set new ticks between each alarm
    pulse_counter_ticks = std::min(counter_us_to_ticks(stepper_pulse_counter_dev, usec_per_pulse),
                                   counter_get_top_value(stepper_pulse_counter_dev));

    // Kick off new counter
    static counter_alarm_cfg pulse_counter_cfg = {
            .callback = pulse,
            .ticks = pulse_counter_ticks,
            .user_data = nullptr,
            .flags = 0
    };
    err = counter_set_channel_alarm(stepper_pulse_counter_dev, COUNTER_CHANNEL, &pulse_counter_cfg);
    if (err) {
        LOG_ERR("Failed to set counter top: err %d", err);
    }

    state = RUNNING;
}

void throttle_valve_stop() {
    k_mutex_lock(&motor_lock, K_FOREVER);
    counter_stop(stepper_pulse_counter_dev);
    acceleration = 0;
    velocity = 0;
    state = STOPPED;
    k_mutex_unlock(&motor_lock);
}

/// Get the current acceleration in deg/s^2. It is only updated per call to
/// throttle_valve_move.
float throttle_valve_get_acceleration() {
    return acceleration;
}

/// Get the current velocity in deg/s. It is only updated per call to
/// throttle_valve_move.
float throttle_valve_get_velocity() {
    return velocity;
}

/// Get current degree position of motor in degrees.
float throttle_valve_get_pos() {
    return static_cast<float>(steps) * DEG_PER_STEP;
}

/// Get interval between each call to pulse counter.
uint64_t throttle_valve_get_nsec_per_pulse() {
    return k_cyc_to_ns_near64(true_interval);
}

int throttle_valve_set_open() {
    k_mutex_lock(&motor_lock, K_FOREVER);
    if (state != MotorState::STOPPED) {
        k_mutex_unlock(&motor_lock);
        LOG_ERR("Cannot reset to position open when motor is stopped.");
        return 1;
    }
    steps = static_cast<int>(90.0f / DEG_PER_STEP);
    k_mutex_unlock(&motor_lock);
    return 0;
}

int throttle_valve_set_closed() {
    k_mutex_lock(&motor_lock, K_FOREVER);
    if (state != MotorState::STOPPED) {
        k_mutex_unlock(&motor_lock);
        LOG_ERR("Cannot reset to position closed when motor is stopped.");
        return 1;
    }
    steps = 0;
    k_mutex_unlock(&motor_lock);
    return 0;
}
```

## src/throttle_valve.h
```c
#ifndef CLOVER_THROTTLEVALVE_H
#define CLOVER_THROTTLEVALVE_H

#include <cstdint>

int throttle_valve_init();

int throttle_valve_start_calibrate();

float throttle_valve_get_pos();

float throttle_valve_get_velocity();

float throttle_valve_get_acceleration();

uint64_t throttle_valve_get_nsec_per_pulse();

void throttle_valve_move(float degrees);

void throttle_valve_stop();

int throttle_valve_set_open();

int throttle_valve_set_closed();

#endif //CLOVER_THROTTLEVALVE_H
```
